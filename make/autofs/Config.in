## make/libs/Config.in
```kconfig
menu "Apache Portable Runtime libs"
	source "make/libs/apr/Config.in"
	source "make/libs/apr-util/Config.in"
endmenu ### "Apache Portable Runtime libs"

menu "Avahi libraries"
	source "make/avahi/Config.in.libs"
endmenu ### "Avahi libraries"

menu "Charsets & Internationalization"
	source "make/iconv/Config.in.libs"
	source "make/libs/gettext/Config.in"
endmenu ### "Charsets & Internationalization"

menu "Crypto & SSL"
	comment "GnuPG ----------------------------------"
		source "make/libs/libgpg-error/Config.in"
		source "make/libs/libgcrypt/Config.in"
	comment "GnuTLS ---------------------------------"
		source "make/gnutls/Config.in.libs"
		source "make/libs/libtasn1/Config.in"
	comment "mbed TLS -------------------------------"
		source "make/libs/mbedtls/Config.in"
	comment "Nettle ---------------------------------"
		source "make/libs/nettle/Config.in"
	comment "OpenSSL --------------------------------"
		source "make/openssl/Config.in.libs"
		source "make/libs/libavmhmac/Config.in"
	comment "PolarSSL -------------------------------"
		source "make/libs/polarssl12/Config.in"
		source "make/libs/polarssl13/Config.in"
	comment "SSH ------------------------------------"
		source "make/libs/libssh2/Config.in"
endmenu ### "Crypto & SSL"

menu "Data compression"
	source "make/libs/lz4/Config.in"
	source "make/xz/Config.in.libs"
	source "make/libs/lzo/Config.in"
	source "make/libs/zlib/Config.in"
endmenu ### "Data compression"

menu "Database"
	source "make/libs/db/Config.in"
	source "make/sqlite/Config.in.libs"
endmenu ### "Database"

menu "File systems"
	source "make/e2fsprogs/Config.in.libs"
	source "make/fuse/Config.in.libs"
	source "make/ntfs/Config.in.libs"
endmenu ### "File systems"

menu "GCC"
	source "make/libs/libatomic/Config.in"
	source "make/libs/libgcc_s/Config.in"
	source "make/libs/libstdcxx/Config.in"
endmenu ### "GCC"

menu "GLib"
	source "make/libs/glib2/Config.in"
endmenu ### "GLib"

menu "Graphics & fonts"
	source "make/libs/freetype/Config.in"
	source "make/libs/libart_lgpl/Config.in"
	source "make/libs/libexif/Config.in"
	source "make/libs/jpeg/Config.in"
	source "make/libs/leptonica/Config.in"
	source "make/libs/libpng/Config.in"
	source "make/libs/libgd/Config.in"
	source "make/libs/openjpeg/Config.in"
	source "make/tesseract/Config.in.libs"
	source "make/tiff/Config.in.libs"
	source "make/netpbm/Config.in.libs"
endmenu ### "Graphics & fonts"

menu "Multi precision arithmetic libs"
	source "make/libs/gmp/Config.in"
	source "make/libs/mpfr/Config.in"
	source "make/libs/mpc/Config.in"
endmenu ### "Multi precision arithmetic libs"

menu "Multimedia"
	source "make/libs/libdvbcsa/Config.in"
	menu "Audio and video codecs"
		menu "Audio codecs"
			source "make/libs/flac/Config.in"
			source "make/libs/libmad/Config.in"
			source "make/libs/libogg/Config.in"
			source "make/libs/opus/Config.in"
			source "make/libs/speex/Config.in"
		endmenu
		source "make/ffmpeg/Config.in.libs"
		menu "Video codecs"
			comment "Vorbis video codec ---------------------"
			source "make/libs/libvorbis/Config.in"
		endmenu
	endmenu ## "Audio and video codecs"
	menu "ID3 tag reading libs"
		source "make/libs/libid3tag/Config.in"
		source "make/libs/taglib/Config.in"
	endmenu ## "ID3 tag reading libs"
endmenu ### "Multimedia"

menu "ncurses"
	source "make/libs/ncurses/Config.in"
	source "make/libs/ncursesw/Config.in"
endmenu ### "ncurses"

menu "Networking"
	comment "ATM ------------------------------------"
		source "make/libs/linux-atm/Config.in"
	comment "Bluetooth ------------------------------"
		source "make/libs/bluez-libs/Config.in"
		source "make/libs/openobex/Config.in"
	comment "ISDN & CAPI ----------------------------"
		source "make/libs/libcapi/Config.in"
	comment "Misc networking ------------------------"
		source "make/libs/libdnet/Config.in"
		source "make/libs/libgsm/Config.in"
		source "make/libs/iksemel/Config.in"
		source "make/libs/ldns/Config.in"
		source "make/libs/libmnl/Config.in"
		source "make/libs/libnet/Config.in"
		source "make/libs/liboping/Config.in"
		source "make/libs/libosip2/Config.in"
		source "make/libs/libpcap/Config.in"
		source "make/libs/spandsp/Config.in"
		source "make/libs/srtp/Config.in"
		source "make/libs/libtirpc/Config.in"
		source "make/unbound/Config.in.libs"
endmenu ### "Networking"

menu "PJ Project"
	source "make/libs/pjproject2/Config.in"
endmenu ### "PJ Project"

menu "Readline"
	source "make/libs/readline/Config.in"
endmenu ### "Readline"

menu "Regular expressions"
	source "make/libs/libonig/Config.in"
	source "make/libs/pcre/Config.in"
endmenu ### "Regular expressions"

menu "uClibc"
	source "make/libs/uclibc/Config.in"
	source "make/libs/uclibcxx/Config.in"
endmenu ### "uClibc"

menu "USB & FTDI"
	source "make/libs/libusb/Config.in"
	source "make/libs/libusb1/Config.in"
	source "make/libs/libftdi/Config.in"
endmenu ### "USB & FTDI"

menu "Web and WebDAV"
	source "make/curl/Config.in.libs"
	source "make/libs/jansson/Config.in"
	source "make/js/Config.in.libs"
	source "make/libs/neon/Config.in"
	source "make/libs/serf/Config.in"
endmenu ### "Web and WebDAV"

menu "XML & XSLT"
	source "make/libs/expat/Config.in"
	source "make/libs/libxml2/Config.in"
	source "make/xsltproc/Config.in.libs"
endmenu ### "XML & XSLT"

source "make/libs/attr/Config.in"
source "make/libs/libcap/Config.in"
source "make/dbus/Config.in.libs"
source "make/libs/libconfig/Config.in"
source "make/libs/libdaemon/Config.in"
source "make/libs/devmapper/Config.in"
source "make/libs/libelf/Config.in"
source "make/libs/libev/Config.in"
source "make/libs/libevent/Config.in"
source "make/libs/libffi/Config.in"
source "make/libs/libctlmgr/Config.in"
source "make/libs/libmultid/Config.in"
source "make/libs/libtool/Config.in"
source "make/lua/Config.in.libs"
source "make/pcsc-lite/Config.in.libs"
source "make/libs/popt/Config.in"
source "make/privatekeypassword/Config.in.libs"
source "make/libs/protobuf-c/Config.in"
source "make/python/Config.in.libs"
source "make/rrdtool/Config.in.libs"
source "make/slang/Config.in.libs"
source "make/libs/libsynce/Config.in"
source "make/libs/sysfsutils/Config.in"
source "make/libs/yaml/Config.in"
```

## make/ntfs/Config.in
```kconfig
config FREETZ_PACKAGE_NTFS
	bool "NTFS-3G 2017.3.23 (binary only)"
	depends on !FREETZ_AVMPLUGINS_NTFS && !(FREETZ_AVM_HAS_NTFS && !FREETZ_REMOVE_NTFS) && FREETZ_REPLACE_MODULE_AVAILABLE
	select FREETZ_LIB_libpthread
	select FREETZ_LIB_libntfs
	select FREETZ_MODULE_fuse if FREETZ_KERNEL_VERSION_4_9_MIN
	default n
	help
		The NTFS-3G driver is an open source, freely available read/write NTFS
		driver for Linux, FreeBSD, OS X, and NetBSD. It provides safe and fast
		handling of the Windows XP, Windows Server 2003, Windows 2000 and
		Windows Vista file systems. Most POSIX file system operations are
		supported, with the exception of full file ownership and access right
		support.
		This binary is needed for ntfs automount feature thus there is no
		webinterface.

menu "ntfsprogs"
	visible if FREETZ_PACKAGE_NTFS

config FREETZ_PACKAGE_NTFS_mkntfs
	bool "mkntfs"
	depends on FREETZ_PACKAGE_NTFS
	default n
	help
		Create an NTFS filesystem.

config FREETZ_PACKAGE_NTFS_ntfscat
	bool "ntfscat"
	depends on FREETZ_PACKAGE_NTFS
	default n
	help
		Dump a file's content to the standard output.

config FREETZ_PACKAGE_NTFS_ntfsclone
	bool "ntfsclone"
	depends on FREETZ_PACKAGE_NTFS
	default n
	help
		Efficiently clone, backup, restore or rescue NTFS.

config FREETZ_PACKAGE_NTFS_ntfscluster
	bool "ntfscluster"
	depends on FREETZ_PACKAGE_NTFS
	default n
	help
		Locate the files which use the given sectors or  clusters.

config FREETZ_PACKAGE_NTFS_ntfscmp
	bool "ntfscmp"
	depends on FREETZ_PACKAGE_NTFS
	default n
	help
		Compare two NTFS filesystems and tell the differences.

config FREETZ_PACKAGE_NTFS_ntfscp
	bool "ntfscp"
	depends on FREETZ_PACKAGE_NTFS
	default n
	help
		Copy a file to an NTFS volume.

config FREETZ_PACKAGE_NTFS_ntfsfix
	bool "ntfsfix"
	depends on FREETZ_PACKAGE_NTFS
	default n
	help
		Check  and fix some common errors, clear the LogFile and make Windows perform
		a thorough check next time it boots.

config FREETZ_PACKAGE_NTFS_ntfsinfo
	bool "ntfsinfo"
	depends on FREETZ_PACKAGE_NTFS
	default n
	help
		Show information about NTFS or one of the files or directories within it.

config FREETZ_PACKAGE_NTFS_ntfslabel
	bool "ntfslabel"
	depends on FREETZ_PACKAGE_NTFS
	default n
	help
		Show, or set, an NTFS filesystem's volume label.

config FREETZ_PACKAGE_NTFS_ntfsls
	bool "ntfsls"
	depends on FREETZ_PACKAGE_NTFS
	default n
	help
		List information about files in a directory residing on an NTFS.

config FREETZ_PACKAGE_NTFS_ntfsresize
	bool "ntfsresize"
	depends on FREETZ_PACKAGE_NTFS
	default n
	help
		Resize NTFS without losing data.

config FREETZ_PACKAGE_NTFS_ntfsundelete
	bool "ntfsundelete"
	depends on FREETZ_PACKAGE_NTFS
	default n
	help
		Recover deleted files from NTFS.

endmenu
```

## make/openvpn/Config.in
```kconfig
comment "OpenVPN (not available, needs kernel modules)"
	depends on \
		!( FREETZ_REPLACE_MODULE_AVAILABLE || FREETZ_AVM_HAS_TUN_BUILTIN ) || \
		!( FREETZ_REPLACE_MODULE_AVAILABLE || !FREETZ_AVM_HAS_BUGON_IN_NET_CORE )

config FREETZ_PACKAGE_OPENVPN
	bool "OpenVPN 2.4.11/2.5.3"
	depends on FREETZ_REPLACE_MODULE_AVAILABLE || FREETZ_AVM_HAS_TUN_BUILTIN
	depends on FREETZ_REPLACE_MODULE_AVAILABLE || !FREETZ_AVM_HAS_BUGON_IN_NET_CORE
	select FREETZ_BUSYBOX_BRCTL         if !FREETZ_PACKAGE_BRIDGE_UTILS
	select FREETZ_MODULE_tun            if !FREETZ_AVM_HAS_TUN_BUILTIN
	select FREETZ_MODULE_yf_patchkernel if FREETZ_AVM_HAS_BUGON_IN_NET_CORE
	default n
	help
		VPN Server

if FREETZ_PACKAGE_OPENVPN


#choice
#	prompt "Version"
#		default FREETZ_PACKAGE_OPENVPN_VERSION_CURRENT

	config FREETZ_PACKAGE_OPENVPN_VERSION_ABANDON
		bool #"2.4.x"
		depends on FREETZ_KERNEL_VERSION_2_6_13
		default y

	config FREETZ_PACKAGE_OPENVPN_VERSION_CURRENT
		bool #"2.5.x"
		depends on !FREETZ_KERNEL_VERSION_2_6_13
		default y

#endchoice


choice
	prompt "GUI"
	default FREETZ_PACKAGE_OPENVPN_USE_V1_CGI

	config FREETZ_PACKAGE_OPENVPN_USE_V0_CGI
		bool "none - binary only"
		depends on FREETZ_SHOW_ADVANCED
		help
			No configuration interface, just the binary.

	config FREETZ_PACKAGE_OPENVPN_USE_V1_CGI
		bool "v1 - old full featured"
		select FREETZ_PACKAGE_OPENVPN_CGI
		help
			Old full featured OpenVPN configuration interface v1.

			CAUTION: You have to delete configurations made with "new"/v2 GUI!
			They share to save the same directory and are not compatible.

	config FREETZ_PACKAGE_OPENVPN_USE_V2_CGI
		bool "v2 - new simple-gui"
		depends on FREETZ_SHOW_ADVANCED
		select FREETZ_PACKAGE_OPENVPN_V2_CGI
		help
			New quite simple OpenVPN configuration interface v2.

			It will not generate a configuration file based on GUI settings
			but just ask for an existing configuration.

			CAUTION: You have to delete configurations made with "old"/v1 GUI!
			They share to save the same directory and are not compatible.

endchoice


choice
	prompt "SSL library"
	default FREETZ_PACKAGE_OPENVPN_OPENSSL

	config FREETZ_PACKAGE_OPENVPN_OPENSSL
		bool "OpenSSL"
		select FREETZ_LIB_libcrypto if ! FREETZ_PACKAGE_OPENVPN_STATIC
		select FREETZ_LIB_libssl    if ! FREETZ_PACKAGE_OPENVPN_STATIC
	config FREETZ_PACKAGE_OPENVPN_MBEDTLS
	bool "mbed TLS"
		select FREETZ_LIB_libmbedcrypto if ! FREETZ_PACKAGE_OPENVPN_STATIC
		select FREETZ_LIB_libmbedtls    if ! FREETZ_PACKAGE_OPENVPN_STATIC
		select FREETZ_LIB_libmbedx509   if ! FREETZ_PACKAGE_OPENVPN_STATIC
		help
			Leads to smaller binaries, but lacks support for some openssl features.

endchoice


config FREETZ_PACKAGE_OPENVPN_FORCE_BLOWFISH
	bool "Include cipher blowfish in mbedTLS"
	depends on FREETZ_PACKAGE_OPENVPN_MBEDTLS
	select FREETZ_LIB_libmbedcrypto_WITH_BLOWFISH if FREETZ_PACKAGE_OPENVPN_MBEDTLS
	default n
	help
		Compile mbedTLS with support for OpenVPN default cipher "blowfish" (BF-CBC).
		Library/Binary size will increase approx. 7k (uncompressed).

config FREETZ_PACKAGE_OPENVPN_WITH_BLOWFISH
	bool
	depends on FREETZ_PACKAGE_OPENVPN_OPENSSL \
		|| (FREETZ_PACKAGE_OPENVPN_MBEDTLS  && FREETZ_LIB_libmbedcrypto_WITH_BLOWFISH)
	default y

config FREETZ_PACKAGE_OPENVPN_STATIC
	bool "Link statically"
	default n
	help
		Causes all libraries OpenVPN depends on to be linked in statically.

config FREETZ_PACKAGE_OPENVPN_WITH_LZO
	bool "With LZO compression"
	select FREETZ_LIB_liblzo2 if ! FREETZ_PACKAGE_OPENVPN_STATIC
	default y
	help
		LZO compression for VPN traffic

config FREETZ_PACKAGE_OPENVPN_WITH_LZ4
	bool "With LZ4 compression"
	select FREETZ_LIB_liblz4 if ! FREETZ_PACKAGE_OPENVPN_STATIC
	default n
	help
		LZ4 compression for VPN traffic

config FREETZ_PACKAGE_OPENVPN_WITH_TRAFFIC_OBFUSCATION
	bool "With traffic obfuscation"
	default n
	help
		Adds support for an additional configuration option 'scramble'
		with the following possible values:
		 * scramble xormask xor_string
		 * scramble reverse
		 * scramble xorptrpos
		 * scramble obfuscate password
		See https://tunnelblick.net/cOpenvpn_xorpatch.html
		
		WARNING:
		scramble-option and SSLH are NOT compatible. SSLH is not
		able to recognize OpenVPN traffic if 'scramble'-option
		is enabled in OpenVPN config. Don't enable it if you plan
		to use SSLH to demultiplex OpenVPN protocol.

comment "Warning: OpenVPN traffic obfuscation and SSLH are not compatible"
	depends on FREETZ_PACKAGE_OPENVPN_WITH_TRAFFIC_OBFUSCATION && FREETZ_PACKAGE_SSLH

config FREETZ_PACKAGE_OPENVPN_WITH_MGMNT
	bool "Enable Management Console"
	default n
	help
		Enables OpenVPN's Management Console for administrative Tasks.
		This feature is not configurable via Web-UI.

config FREETZ_PACKAGE_OPENVPN_ENABLE_SMALL
	bool "Optimize for size"
	default y
	help
		Enables binary optimiziation for size.
		Must be disabled to use the config option "explicit-exit-notify".

config FREETZ_PACKAGE_OPENVPN_USE_IPROUTE
	bool "Use 'ip' instead of 'ifconfig' and 'route'"
	select FREETZ_BUSYBOX_IP
	default n
	help
		Enables openvpn to use ip when setting IPs, link parameters and routes.
		This selects busybox's 'IP' applet.

endif # FREETZ_PACKAGE_OPENVPN
```

## make/p7zip/Config.in
```kconfig
config FREETZ_PACKAGE_P7ZIP
	bool "p7zip 16.02 (binary only)"
	default n
	help
		7-Zip  is  a  file  archiver  with the highest compression ratio. The program 
		supports 7z (that implements LZMA compression algorithm), ZIP, CAB, ARJ, GZIP, 
		BZIP2, TAR, CPIO, RPM and DEB formats. Compression ratio in the new 7z format 
		is 30-50% better  than ratio in ZIP format.
```

## make/pcsc-lite/Config.in
```kconfig
config FREETZ_PACKAGE_PCSC_LITE
	bool "PCSC-lite (pcscd) 1.9.0 (binary only)"
	select FREETZ_LIB_libdl
	select FREETZ_LIB_libpthread
	select FREETZ_LIB_librt
	select FREETZ_LIB_libusb_1
	select FREETZ_LIB_libpcsclite # loaded per dlopen
	default n
	help
		The purpose of PCSC Lite is to provide a Windows(R)
		SCard interface in a very small form factor for
		communicating to smart cards and readers.
```

## make/sshfs-fuse/Config.in
```kconfig
config FREETZ_PACKAGE_SSHFS_FUSE
	bool "sshfs-fuse 2.4"
	select FREETZ_PACKAGE_FUSE
	select FREETZ_PACKAGE_DROPBEAR_SERVER_ONLY if FREETZ_PACKAGE_DROPBEAR
	select FREETZ_PACKAGE_OPENSSH
	select FREETZ_PACKAGE_OPENSSH_ssh
	select FREETZ_PACKAGE_OPENSSH_sftp
	select FREETZ_LIB_libgthread_2
	default n
	help
		This is a filesystem client based on the SSH File Transfer Protocol.
		Since most SSH servers already support this protocol it is very easy to set up:
		i.e. on the server side there's nothing to do.
		On the client side mounting the filesystem is as easy as
		logging into the server with ssh.

config FREETZ_PACKAGE_SSHFS_FUSE_REMOVE_WEBIF
	bool "remove webinterface"
	depends on FREETZ_PACKAGE_SSHFS_FUSE
	default n
	help
		This option removes the webinterface
```
