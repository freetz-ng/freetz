## make/autofs/Config.in
```kconfig
comment "autofs (not available, needs replace kernel)"
	depends on !FREETZ_AVM_HAS_AUTOFS4_BUILTIN
	depends on FREETZ_KERNEL_VERSION_2_6_28_MAX && !FREETZ_REPLACE_KERNEL

comment "autofs (not available, no kernel sources from AVM)"
	depends on !FREETZ_AVM_HAS_AUTOFS4_BUILTIN
	depends on FREETZ_KERNEL_VERSION_2_6_32_MIN && !FREETZ_REPLACE_MODULE_AVAILABLE

config FREETZ_PACKAGE_AUTOFS
	bool "autofs 5.0.5/5.1.6"
	depends on FREETZ_AVM_HAS_AUTOFS4_BUILTIN \
		|| (FREETZ_KERNEL_VERSION_2_6_28_MAX && FREETZ_REPLACE_KERNEL) \
		|| (FREETZ_KERNEL_VERSION_2_6_32_MIN && FREETZ_REPLACE_MODULE_AVAILABLE)
	select FREETZ_LIB_libdl
	select FREETZ_LIB_libpthread
	select FREETZ_MODULE_autofs4 if !FREETZ_AVM_HAS_AUTOFS4_BUILTIN
	select FREETZ_BUSYBOX_FEATURE_MOUNT_HELPERS
	select FREETZ_BUSYBOX_FEATURE_MOUNT_LABEL
	default n
	help
		Autofs is a kernel-based automounter for Linux. It performs a job
		similar to amd(8) but relies on a small stub of kernel code instead of
		pretending to be an NFS server. The result is simpler code, better
		reliability, and much faster operation in the common case (everything
		already mounted).

if FREETZ_PACKAGE_AUTOFS && FREETZ_REPLACE_MODULE_AVAILABLE

config FREETZ_PACKAGE_AUTOFS_NFS
	bool "select nfs module"
	select FREETZ_MODULE_nfs if FREETZ_NFS_SUPPORT_AVAILABLE_AS_MODULE
	default n
	help
		Select this if you want to mount NFS-shares.

comment "select cifs package (not available, needs replace kernel)"
	depends on !FREETZ_REPLACE_KERNEL && FREETZ_KERNEL_VERSION_2_6_28_MIN && !FREETZ_KERNEL_VERSION_3_MIN

config FREETZ_PACKAGE_AUTOFS_CIFS
	bool "select cifs package"
	depends on  FREETZ_REPLACE_KERNEL || FREETZ_KERNEL_VERSION_2_6_19_MAX ||  FREETZ_KERNEL_VERSION_3_MIN
	select FREETZ_PACKAGE_CIFSMOUNT
	select FREETZ_PACKAGE_CIFSMOUNT_REMOVE_WEBIF if FREETZ_PACKAGE_AUTOFS_REMOVE_ALL_WEBIF
	default n
	help
		Select this if you want to mount SMB-shares.

config FREETZ_PACKAGE_AUTOFS_CURLFTPFS
	bool "select curlftpfs package"
	depends on !FREETZ_TARGET_UCLIBC_0_9_28
	select FREETZ_PACKAGE_CURLFTPFS
	select FREETZ_PACKAGE_CURLFTPFS_REMOVE_WEBIF if FREETZ_PACKAGE_AUTOFS_REMOVE_ALL_WEBIF
	default n
	help
		Select this if you want to mount FTP-shares.

config FREETZ_PACKAGE_AUTOFS_DAVFS2
	bool "select davfs2 package"
	select FREETZ_PACKAGE_DAVFS2
	select FREETZ_PACKAGE_DAVFS2_REMOVE_WEBIF if FREETZ_PACKAGE_AUTOFS_REMOVE_ALL_WEBIF
	default n
	help
		Select this if you want to mount WebDAV-shares.
		Support for SSL and ZLIB could additionally be selected!

config FREETZ_PACKAGE_AUTOFS_SSHFS
	bool "select sshfs package"
	select FREETZ_PACKAGE_SSHFS_FUSE
	select FREETZ_PACKAGE_SSHFS_FUSE_REMOVE_WEBIF if FREETZ_PACKAGE_AUTOFS_REMOVE_ALL_WEBIF
	default n
	help
		Select this if you want to mount SSH-shares.

config FREETZ_PACKAGE_AUTOFS_REMOVE_ALL_WEBIF
	bool "remove web interfaces of all selected packages"
	default n
	help
		Select this option if you want to remove the web interfaces of all selected packages

endif # FREETZ_PACKAGE_AUTOFS
```

## make/ca-bundle/Config.in
```kconfig
config FREETZ_PACKAGE_CA_BUNDLE
	bool "CA-bundle 2021-04-13"
	default n
	help
		The Mozilla CA certificate store in PEM format,
		see https://www.curl.se/docs/caextract.html
		Size of uncompressed file is about 250 KB.
```

## make/ccid/Config.in
```kconfig
config FREETZ_PACKAGE_CCID
	bool "CCID driver 1.4.33"
	select FREETZ_LIB_libpthread
	select FREETZ_LIB_libusb_1
	select FREETZ_PACKAGE_PCSC_LITE
	default n
	help
		ccid provides the source code for a generic USB
		CCID (Chip/Smart Card Interface Devices) driver and
		ICCD (Integrated Circuit(s) Card Devices).
```

## make/curl/Config.in
```kconfig
config FREETZ_PACKAGE_CURL
	bool "Curl 7.76.0 (binary only)"
	default n
	select FREETZ_LIB_libcurl if ! FREETZ_PACKAGE_CURL_STATIC
	help
		Curl is a command line tool for transferring files with URL syntax,
		supporting FTP, FTPS, HTTP, HTTPS, GOPHER, TELNET, DICT, FILE and LDAP.
		Curl supports HTTPS certificates, HTTP POST, HTTP PUT, FTP uploading,
		kerberos, HTTP form based upload, proxies, cookies, user+password
		authentication, file transfer resume, http proxy tunneling and a
		busload of other useful tricks.

if FREETZ_PACKAGE_CURL

config FREETZ_PACKAGE_CURL_SELECT_SSL
	bool "Select SSL support"
	default y
	select FREETZ_LIB_libcurl_WITH_SSL

config FREETZ_PACKAGE_CURL_SELECT_CA_BUNDLE
	bool "Select CA-bundle"
	depends on FREETZ_PACKAGE_CURL_SELECT_SSL
	default y
	select FREETZ_PACKAGE_CA_BUNDLE

config FREETZ_PACKAGE_CURL_SELECT_SFTP
	bool "Select sftp support"
	default n
	select FREETZ_LIB_libcurl_WITH_SFTP

config FREETZ_PACKAGE_CURL_SELECT_ZLIB
	bool "Select zlib support"
	default n
	select FREETZ_LIB_libcurl_WITH_ZLIB

config FREETZ_PACKAGE_CURL_STATIC
	bool "Link statically"
	default n
	help
		Causes all libraries curl binary depends on to be linked in statically

endif # FREETZ_PACKAGE_CURL
```

## make/davfs2/Config.in
```kconfig
config FREETZ_PACKAGE_DAVFS2
	bool "davfs 1.5.2"
	depends on FREETZ_REPLACE_MODULE_AVAILABLE
	select FREETZ_LIB_libiconv if FREETZ_TARGET_UCLIBC_0_9_28
	select FREETZ_LIB_libneon
	select FREETZ_MODULE_fuse if ! FREETZ_MODULE_coda && FREETZ_KERNEL_VERSION_4_9_MIN
	select FREETZ_BUSYBOX_FEATURE_MOUNT_HELPERS
	select FREETZ_BUSYBOX_FEATURE_MOUNT_LABEL
	select FREETZ_REMOVE_WEBDAV if FREETZ_AVM_HAS_WEBDAV
	default n
	help
		davfs is a Linux file system driver that allows you to mount a
		WebDAV server as a disk drive. WebDAV is an extension to
		HTTP/1.1 that allows remote collaborative authoring of Web
		resources, defined in RFC 4918.

config FREETZ_PACKAGE_DAVFS2_REMOVE_WEBIF
	bool "remove webinterface"
	depends on FREETZ_PACKAGE_DAVFS2
	default n
	help
		This option removes the webinterface

config FREETZ_PACKAGE_DAVFS2_WITH_SSL
	bool "build with SSL support"
	depends on FREETZ_PACKAGE_DAVFS2
	select FREETZ_LIB_libneon_WITH_SSL
	default n
	help
		This option enables SSL support.

config FREETZ_PACKAGE_DAVFS2_WITH_ZLIB
	bool "build with zlib support"
	depends on FREETZ_PACKAGE_DAVFS2
	select FREETZ_LIB_libneon_WITH_ZLIB
	default n
	help
		This option enables zlib support.
```

## make/diffutils/Config.in
```kconfig
config FREETZ_PACKAGE_DIFFUTILS
	bool "diffutils 3.7 (binary only)"
	default n
	select FREETZ_PACKAGE_DIFFUTILS_DIFF
	help
		GNU Diffutils is a package of several programs related to finding differences between files.
		Provides the following tools from diffutils-package: diff, diff3, sdiff, cmp

config FREETZ_PACKAGE_DIFFUTILS_DIFF
	bool "Include diff"
	depends on FREETZ_PACKAGE_DIFFUTILS
	default y
	help
		Include diff in the image

config FREETZ_PACKAGE_DIFFUTILS_DIFF3
	bool "Include diff3"
	depends on FREETZ_PACKAGE_DIFFUTILS
	default n
	help
		Include diff3 in the image

config FREETZ_PACKAGE_DIFFUTILS_SDIFF
	bool "Include sdiff"
	depends on FREETZ_PACKAGE_DIFFUTILS
	default n
	help
		Include sdiff in the image

config FREETZ_PACKAGE_DIFFUTILS_CMP
	bool "Include cmp"
	depends on FREETZ_PACKAGE_DIFFUTILS
	default n
	help
		Include cmp in the image
```

## make/e2fsprogs/Config.in
```kconfig
config FREETZ_PACKAGE_E2FSPROGS
	bool "e2fsprogs 1.45.6 (binary only)"
	depends on FREETZ_REMOVE_AVM_E2FSPROGS
	default n
	help
		This package contains essential ext2, ext3 and ext4 filesystem
		utilities which consists of e2fsck, mke2fs, debugfs, dumpe2fs,
		tune2fs, and most of the other core ext2 filesystem utilities.
		Homepage: http://e2fsprogs.sourceforge.net/

config FREETZ_PACKAGE_E2FSPROGS_E2FSCK
	bool "Checking Tools"
	default n
	depends on FREETZ_PACKAGE_E2FSPROGS
	select FREETZ_LIB_libblkid	if FREETZ_PACKAGE_E2FSPROGS_ALL_DYN
	select FREETZ_LIB_libcom_err	if FREETZ_PACKAGE_E2FSPROGS_ALL_DYN
	select FREETZ_LIB_libe2p	if FREETZ_PACKAGE_E2FSPROGS_ALL_DYN
	select FREETZ_LIB_libext2fs	if FREETZ_PACKAGE_E2FSPROGS_ALL_DYN
	select FREETZ_LIB_libuuid	if FREETZ_PACKAGE_E2FSPROGS_ALL_DYN
	help
		Copy e2fsck, fsck and the fsck.ext* symlinks to image

config FREETZ_PACKAGE_E2FSPROGS_E2MAKING
	bool "Making tools"
	default n
	depends on FREETZ_PACKAGE_E2FSPROGS
	select FREETZ_LIB_libblkid	if FREETZ_PACKAGE_E2FSPROGS_ALL_DYN
	select FREETZ_LIB_libcom_err	if FREETZ_PACKAGE_E2FSPROGS_ALL_DYN
	select FREETZ_LIB_libe2p	if FREETZ_PACKAGE_E2FSPROGS_ALL_DYN
	select FREETZ_LIB_libext2fs	if FREETZ_PACKAGE_E2FSPROGS_ALL_DYN
	select FREETZ_LIB_libuuid	if FREETZ_PACKAGE_E2FSPROGS_ALL_DYN
	help
		Copy mke2fs, the mkfs.ext* symlinks and mklost+found to image

config FREETZ_PACKAGE_E2FSPROGS_E2TUNING
	bool "Tuning tools"
	default n
	depends on FREETZ_PACKAGE_E2FSPROGS
	select FREETZ_LIB_libblkid	if FREETZ_PACKAGE_E2FSPROGS_ALL_DYN
	select FREETZ_LIB_libcom_err	if FREETZ_PACKAGE_E2FSPROGS_ALL_DYN
	select FREETZ_LIB_libe2p	if FREETZ_PACKAGE_E2FSPROGS_ALL_DYN
	select FREETZ_LIB_libext2fs	if FREETZ_PACKAGE_E2FSPROGS_ALL_DYN
	select FREETZ_LIB_libuuid	if FREETZ_PACKAGE_E2FSPROGS_ALL_DYN
	help
		Copy tune2fs, chattr, lsattr and dumpe2fs to image

config FREETZ_PACKAGE_E2FSPROGS_E2DEBUG
	bool "Debugging tools"
	default n
	depends on FREETZ_PACKAGE_E2FSPROGS
	select FREETZ_LIB_libblkid	if FREETZ_PACKAGE_E2FSPROGS_ALL_DYN
	select FREETZ_LIB_libcom_err	if FREETZ_PACKAGE_E2FSPROGS_ALL_DYN
	select FREETZ_LIB_libe2p	if FREETZ_PACKAGE_E2FSPROGS_ALL_DYN
	select FREETZ_LIB_libext2fs	if FREETZ_PACKAGE_E2FSPROGS_ALL_DYN
	select FREETZ_LIB_libss		if FREETZ_PACKAGE_E2FSPROGS_ALL_DYN
	select FREETZ_LIB_libuuid	if FREETZ_PACKAGE_E2FSPROGS_ALL_DYN
	help
		Copy e2image, e2undo, debugfs and logsave to image

config FREETZ_PACKAGE_E2FSPROGS_BLKID
	bool "blkid"
	default n
	depends on FREETZ_PACKAGE_E2FSPROGS
	select FREETZ_LIB_libblkid	if FREETZ_PACKAGE_E2FSPROGS_ALL_DYN
	select FREETZ_LIB_libext2fs	if FREETZ_PACKAGE_E2FSPROGS_ALL_DYN
	help
		Copy blkid to image

config FREETZ_PACKAGE_E2FSPROGS_E2FIXING
	bool "Repair and misc. tools"
	default n
	depends on FREETZ_PACKAGE_E2FSPROGS
	select FREETZ_PACKAGE_E2FSPROGS_BLKID if ! FREETZ_BUSYBOX_BLKID
	select FREETZ_LIB_libext2fs	if FREETZ_PACKAGE_E2FSPROGS_ALL_DYN
	select FREETZ_LIB_libcom_err	if FREETZ_PACKAGE_E2FSPROGS_ALL_DYN
	select FREETZ_LIB_libuuid	if FREETZ_PACKAGE_E2FSPROGS_ALL_DYN
	help
		Copy badblocks, filefrag, e2freefrag, uuidd and uuidgen to image

config FREETZ_PACKAGE_E2FSPROGS_E2RESIZE
	bool "Resize tools"
	default n
	depends on FREETZ_PACKAGE_E2FSPROGS
	select FREETZ_LIB_libe2p	if FREETZ_PACKAGE_E2FSPROGS_ALL_DYN
	select FREETZ_LIB_libext2fs	if FREETZ_PACKAGE_E2FSPROGS_ALL_DYN
	select FREETZ_LIB_libcom_err	if FREETZ_PACKAGE_E2FSPROGS_ALL_DYN
	help
		Copy resize2fs to image

choice
	depends on FREETZ_PACKAGE_E2FSPROGS
	prompt "Link"
	default FREETZ_PACKAGE_E2FSPROGS_PKG_STAT

	config FREETZ_PACKAGE_E2FSPROGS_ALL_DYN
		bool "all libraries dynamically"

	config FREETZ_PACKAGE_E2FSPROGS_PKG_STAT
		bool "e2fsprogs libraries statically"

	config FREETZ_PACKAGE_E2FSPROGS_ALL_STAT
		bool "all libraries statically"
endchoice
```

## make/fuse/Config.in
```kconfig
config FREETZ_PACKAGE_FUSE
	bool "FUSE 2.9.7 (binary only)"
	depends on FREETZ_REPLACE_MODULE_AVAILABLE
	select FREETZ_MODULE_fuse if FREETZ_KERNEL_VERSION_4_9_MIN
	select FREETZ_LIB_libfuse
	default n
	help
		Filesystem in Userspace (FUSE) is a free Unix kernel module that allows
		non-privileged users to create their own file systems without the need
		to write any kernel code. This is achieved by running the file
		systemcode in user space, while the FUSE module only provides a "bridge"
		to the actual kernel interfaces. FUSE was officially merged into the
		mainstream Linux kernel tree in kernel version 2.6.14.

		FUSE is particularly useful for writing virtual file systems. Unlike
		traditional filesystems which essentially save data to and retrieve data
		from disk, virtual filesystems do not actually store data themselves.
		They act as a view or translation of an existing filesystem or storage
		device. In principle, any resource available to FUSE implementation can
		be exported as a file system.

		In Freetz, the NTFS package depends on fuse, for example.
```

## make/haproxy/Config.in
```kconfig
config FREETZ_PACKAGE_HAPROXY
	bool "HAProxy 2.2.11"
	select FREETZ_LIB_libcrypt if FREETZ_TARGET_UCLIBC_HAS_multiple_libs
	select FREETZ_BUSYBOX_START_STOP_DAEMON
	default n
	help
		HAProxy is a free, very fast and reliable solution offering high
		availability, load balancing, and proxying for TCP and HTTP-based
		applications.

config FREETZ_PACKAGE_HAPROXY_WITH_OPENSSL
	bool "with OpenSSL support"
	depends on FREETZ_PACKAGE_HAPROXY
	select FREETZ_LIB_libcrypto
	select FREETZ_LIB_libssl
	default n
	help
		This option enables SSL support in HAProxy.

config FREETZ_PACKAGE_HAPROXY_WITH_PCRE
	bool "with regex support (PCRE)"
	depends on FREETZ_PACKAGE_HAPROXY
	select FREETZ_LIB_libpcre
	default n
	help
		This option enables use of libpcre for regex.
```
