## make/strace/Config.in
```kconfig
config FREETZ_PACKAGE_STRACE
	bool "strace 4.9/5.5 (binary only)"
	default n
	help
		strace - trace system calls and signals

		strace is a system call tracer, i.e. a debugging tool which prints out
		a trace of all the system calls made by a another process/program.
```

## make/stunnel/Config.in
```kconfig
config FREETZ_PACKAGE_STUNNEL
	bool "Stunnel 5.58"
	select FREETZ_OPENSSL_VERSION_PROMPT if FREETZ_PACKAGE_STUNNEL_STATIC
	select FREETZ_LIB_libcrypto  if !FREETZ_PACKAGE_STUNNEL_STATIC
	select FREETZ_LIB_libssl     if !FREETZ_PACKAGE_STUNNEL_STATIC
	select FREETZ_LIB_libpthread if !FREETZ_PACKAGE_STUNNEL_STATIC && FREETZ_TARGET_UCLIBC_HAS_multiple_libs
	select FREETZ_LIB_libutil    if !FREETZ_PACKAGE_STUNNEL_STATIC && FREETZ_TARGET_UCLIBC_HAS_multiple_libs
	default n
	help
		Stunnel universal SSL proxy

config FREETZ_PACKAGE_STUNNEL_BOXCERT
	bool "build with support for FRITZ!OS certificate"
	depends on FREETZ_PACKAGE_STUNNEL
	depends on FREETZ_BOX_CERTIFICATE_SUPPORT_AVAILABLE
	select FREETZ_PACKAGE_PRIVATEKEYPASSWORD
	default n
	help
		Building stunnel with FRITZ!OS support enables reuse
		of existing key and certificate from /var/flash

config FREETZ_PACKAGE_STUNNEL_STATIC
	bool "Link statically"
	depends on FREETZ_PACKAGE_STUNNEL
	default n
	help
		Build stunnel binary with statically linked libraries.
```

## make/tor/Config.in
```kconfig
comment "Tor (not available, needs OpenSSL 1.0 or newer)"
	depends on !FREETZ_OPENSSL_VERSION_1_MIN

config FREETZ_PACKAGE_TOR
	bool "Tor 0.4.5.7"
	depends on FREETZ_OPENSSL_VERSION_1_MIN
	select FREETZ_LIB_libm               if !FREETZ_PACKAGE_TOR_STATIC && FREETZ_TARGET_UCLIBC_HAS_multiple_libs
	select FREETZ_LIB_libevent           if !FREETZ_PACKAGE_TOR_STATIC
	select FREETZ_LIB_libcrypto          if !FREETZ_PACKAGE_TOR_STATIC
	select FREETZ_LIB_libcrypto_WITH_EC
	select FREETZ_LIB_libssl             if !FREETZ_PACKAGE_TOR_STATIC
	select FREETZ_LIB_libz               if !FREETZ_PACKAGE_TOR_STATIC
	default n
	help
		The Onion Router

		Anonymous Internet communication system.

if FREETZ_PACKAGE_TOR

config FREETZ_PACKAGE_TOR_GEOIP_V4
	bool "With GeoIP database for IPv4"
	default n
	help
		This includes the GeoIP database for IPv4.
		Needs about 850KB (compressed).

config FREETZ_PACKAGE_TOR_GEOIP_V6
	bool "With GeoIP database for IPv6"
	default n
	help
		This includes the GeoIP database for IPv6.
		Needs about 180 KB (compressed).

config FREETZ_PACKAGE_TOR_STATIC
	bool "Link statically"
	default n
	help
		Build tor binary with statically linked libraries.

endif # FREETZ_PACKAGE_TOR
```

## make/umurmur/Config.in
```kconfig
config FREETZ_PACKAGE_UMURMUR
	bool "uMurmur 0.2.20"
	select FREETZ_LIB_libconfig
	select FREETZ_LIB_libprotobuf_c
	default n
	help
		umurmur is a minimalistic Mumble server primarily
		targeted to run on routers using less resources.
		It targets to fill the needs of a pretty small group
		of users communicating, which in part originates from
		the other goal of working well on a small system with
		a limited CPU and limited amount of disk space. It also
		aims to minimize writing to the disk since these kinds
		of systems usually only has a flash memory for disk.
		umurmur supports a subset of the features of Murmur.
		https://github.com/umurmur/umurmur

choice
	depends on FREETZ_PACKAGE_UMURMUR
	prompt "SSL library"
	default FREETZ_PACKAGE_UMURMUR_OPENSSL

	config FREETZ_PACKAGE_UMURMUR_OPENSSL
		bool "OpenSSL"
		select FREETZ_LIB_libcrypto
		select FREETZ_LIB_libcrypto_WITH_EC
		select FREETZ_LIB_libssl

	config FREETZ_PACKAGE_UMURMUR_MBEDTLS
		bool "mbedTLS"
		select FREETZ_LIB_libmbedcrypto
		select FREETZ_LIB_libmbedcrypto_WITH_GENRSA
		select FREETZ_LIB_libmbedtls
		select FREETZ_LIB_libmbedx509
endchoice
```

## make/unbound/Config.in
```kconfig
menuconfig FREETZ_PACKAGE_UNBOUND
	bool "Unbound 1.13.1"
	select FREETZ_LIB_libssl
	select FREETZ_LIB_libcrypto
	select FREETZ_LIB_libexpat
	select FREETZ_LIB_libunbound
	default n
	help
		 Unbound is designed as a set of modular components, so that also
		 DNSSEC (secure DNS) validation and stub-resolvers (that do not run as
		 a server, but are linked into an application) are easily possible.

if FREETZ_PACKAGE_UNBOUND

	config FREETZ_PACKAGE_UNBOUND_WEBIF
		bool "Add webinterface"
		select FREETZ_PACKAGE_UNBOUND_DAEMON
		default y
		help
			Freetz web interface to configure unbound daemon.

		config FREETZ_PACKAGE_UNBOUND_WEBIF_CRON
			bool "Update root servers"
			depends on FREETZ_PACKAGE_UNBOUND_WEBIF
			select FREETZ_BUSYBOX_MD5SUM
			select FREETZ_PACKAGE_WGET
			select FREETZ_PACKAGE_WGET_WITH_SSL
			select FREETZ_PACKAGE_WGET_CA_BUNDLE
			default y
			help
				Updates root.hints with wget by cron.

	config FREETZ_PACKAGE_UNBOUND_DAEMON
		bool "Binary unbound"
		default n
		help
			unbound - Unbound DNS validating resolver
			
			It  uses a built in list of authoritative nameservers for the root zone
			(.), the so called root hints.  On receiving a DNS query  it  will  ask
			the root nameservers for an answer and will in almost all cases receive
			a delegation to a top level domain (TLD) authoritative nameserver.   It
			will  then ask that nameserver for an answer.  It will recursively con-
			tinue until an answer is found or no answer  is  available  (NXDOMAIN).
			For performance and efficiency reasons that answer is cached for a cer-
			tain time (the answer's time-to-live or TTL).  A second query  for  the
			same  name  will  then be answered from the cache.  Unbound can also do
			DNSSEC validation.

			About 1,1 MB uncompressed.

	config FREETZ_PACKAGE_UNBOUND_ANCHOR
		bool "Binary unbound-anchor"
		default n
		help
			unbound-anchor - Unbound anchor utility.
			
			Unbound-anchor performs setup or update of the root trust anchor for
			DNSSEC validation. The program fetches the trust anchor with the
			method from RFC7958 when regular RFC5011 update fails to bring it up to
			date. It can be run (as root) from the commandline, or run as part of
			startup scripts. Before you start the unbound DNS server.
			
			About 60 kB uncompressed.

	config FREETZ_PACKAGE_UNBOUND_CHECKCONF
		bool "Binary unbound-checkconf"
		default n
		help
			unbound-checkconf - Check unbound configuration file for errors.
			
			Unbound-checkconf checks the configuration file for the unbound DNS
			resolver for syntax and other errors. The config file syntax is de-
			scribed in unbound.conf.
			
			About 1,0 MB uncompressed.

	config FREETZ_PACKAGE_UNBOUND_CONTROL
		bool "Binary unbound-control"
		default n
		help
			unbound-control - Unbound remote server control utility.
			
			Unbound-control performs remote administration on the unbound DNS
			server. It reads the configuration file, contacts the unbound server
			over SSL sends the command and displays the result.
			
			About 1,0 MB uncompressed.

		config FREETZ_PACKAGE_UNBOUND_CONTROL_SETUP
			bool "Script unbound-control-setup"
			depends on FREETZ_PACKAGE_UNBOUND_CONTROL
			select FREETZ_PACKAGE_OPENSSL
			default n
			help
				unbount-control-setup - helper script for unbound-control
				
				About 6 kB uncompressed.

	config FREETZ_PACKAGE_UNBOUND_HOST
		bool "Binary unbound-host"
		default n
		help
			unbound-host - unbound DNS lookup utility
			
			Unbound-host uses the unbound validating resolver to query for the
			hostname and display results. With the -v option it displays validation
			status: secure, insecure, bogus (security failure).
			
			By default it reads no configuration file whatsoever. It attempts to
			reach the internet root servers. With -C an unbound config file and
			with -r resolv.conf can be read.
			
			About 119 kB uncompressed.

endif # FREETZ_PACKAGE_UNBOUND
```
